## cd4067/drivers/cd4067/Kconfig
```kconfig
config CD4067
	bool "CD4067 GPIO mux driver"
	depends on GPIO
	help
	  Enable the out-of-tree CD4067 digital input multiplexer driver.
```

## cd4067/dts/bindings/mux/vnd,cd4067-gpio-mux.yaml
```yaml
description: CD4067 GPIO-controlled digital multiplexer

compatible: "vnd,cd4067-gpio-mux"

include: base.yaml

properties:
  select-gpios:
    type: phandle-array
    required: true
    description: |
      Four GPIOs connected to S0, S1, S2, and S3 in that order.

  sig-gpios:
    type: phandle-array
    required: true
    description: |
      GPIO connected to the common SIG pin of the CD4067.
```
